// SPDX-License-Identifier: (GPL-2.0+ OR MIT)
/*
 * Copyright (c) 2022 Rockchip Electronics Co., Ltd.
 * Copyright (c) 2022 Radxa Limited
 *
 */

/dts-v1/;

#include <dt-bindings/gpio/gpio.h>
#include <dt-bindings/leds/common.h>
#include <dt-bindings/pwm/pwm.h>
#include <dt-bindings/pinctrl/rockchip.h>
#include <dt-bindings/input/rk-input.h>
#include <dt-bindings/display/drm_mipi_dsi.h>
#include <dt-bindings/display/media-bus-format.h>
#include <dt-bindings/display/rockchip_vop.h>
#include <dt-bindings/sensor-dev.h>
#include "dt-bindings/usb/pd.h"
#include "rk3588.dtsi"
#include "rk3588-rk806-single.dtsi"
#include "rk3588-linux.dtsi"

/ {
	model = "DIASOM BTB EVB";
	compatible = "diasom, btb-evb", "rockchip,rk3588";

	aliases {
		ethernet0 = &gmac0;
		ethernet1 = &gmac1;
		i2c9 = &i2c9;
		i2c10 = &i2c10;
		i2c11 = &i2c11;
		i2c12 = &i2c12;
		mmc0 = &sdhci;
		mmc1 = &sdmmc;
	};

	// chosen {
	// 	stdout-path = "serial2:1500000n8";
	// };

	vcc12v_dcin: vcc12v-dcin {
		compatible = "regulator-fixed";
		regulator-name = "vcc12v_dcin";
		regulator-always-on;
		regulator-boot-on;
		regulator-min-microvolt = <12000000>;
		regulator-max-microvolt = <12000000>;
	};

	vcc5v0_sys: vcc5v0-sys {
		compatible = "regulator-fixed";
		regulator-name = "vcc5v0_sys";
		regulator-always-on;
		regulator-boot-on;
		regulator-min-microvolt = <5000000>;
		regulator-max-microvolt = <5000000>;
		vin-supply = <&vcc12v_dcin>;
	};

	vcc_1v1_nldo_s3: vcc-1v1-nldo-s3 {
		compatible = "regulator-fixed";
		regulator-name = "vcc_1v1_nldo_s3";
		regulator-always-on;
		regulator-boot-on;
		regulator-min-microvolt = <1100000>;
		regulator-max-microvolt = <1100000>;
		vin-supply = <&vcc5v0_sys>;
	};

	vcc_1v8_sys: vcc-1v8_sys-regulator {
		compatible = "regulator-fixed";
		regulator-name = "vcc_1v8_sys";
		regulator-always-on;
		regulator-boot-on;
		regulator-min-microvolt = <1800000>;
		regulator-max-microvolt = <1800000>;
		vin-supply = <&vcc5v0_sys>;
	};

	vcc_3v3_sys: vcc-3v3_sys-regulator {
		compatible = "regulator-fixed";
		regulator-name = "vcc_3v3_sys";
		regulator-always-on;
		regulator-boot-on;
		regulator-min-microvolt = <3300000>;
		regulator-max-microvolt = <3300000>;
		vin-supply = <&vcc12v_dcin>;
	};
		
	vcc3v3_pcie30: vcc3v3-pcie30 {
		pinctrl-names = "default";
		pinctrl-0 = <&pcie30_vcc_pins>;
		compatible = "regulator-fixed";
		regulator-name = "vcc3v3_pcie30";
		regulator-min-microvolt = <3300000>;
		regulator-max-microvolt = <3300000>;
		enable-active-high;
		gpios = <&gpio1 RK_PC2 GPIO_ACTIVE_HIGH>;
		startup-delay-us = <5000>;
		vin-supply = <&vcc5v0_sys>;
	};

	vcc5v0_usb2_host: vcc5v0-usb2-host-regulator {
		compatible = "regulator-fixed";
		regulator-name = "vcc5v0_usb2_host";
		regulator-boot-on;
		regulator-always-on;
		regulator-min-microvolt = <5000000>;
		regulator-max-microvolt = <5000000>;
		enable-active-high;
		gpio = <&gpio4 RK_PB0 GPIO_ACTIVE_HIGH>;
		pinctrl-names = "default";
		pinctrl-0 = <&vcc5v0_usb2_host_en>;
		vin-supply = <&vcc5v0_sys>;
	};

	vcc5v0_usb3_host1: vcc5v0-usb3-host1-regulator {
		compatible = "regulator-fixed";
		regulator-name = "vcc5v0_usb3_host1";
		regulator-boot-on;
		regulator-always-on;
		regulator-min-microvolt = <5000000>;
		regulator-max-microvolt = <5000000>;
		enable-active-high;
		gpio = <&gpio4 RK_PB6 GPIO_ACTIVE_HIGH>;
		pinctrl-names = "default";
		pinctrl-0 = <&vcc5v0_usb3_host1_en>;
		vin-supply = <&vcc5v0_sys>;
	};

	vcc5v0_usb3_host2: vcc5v0-usb3-host2-regulator {
		compatible = "regulator-fixed";
		regulator-name = "vcc5v0_usb3_host2";
		regulator-boot-on;
		regulator-always-on;
		regulator-min-microvolt = <5000000>;
		regulator-max-microvolt = <5000000>;
		enable-active-high;
		gpio = <&gpio1 RK_PD4 GPIO_ACTIVE_HIGH>;
		pinctrl-names = "default";
		pinctrl-0 = <&vcc5v0_usb3_host2_en>;
		vin-supply = <&vcc5v0_sys>;
	};

	vcc5v0_usb3_otg: vcc5v0-usb3-otg-regulator {
		compatible = "regulator-fixed";
		regulator-name = "vcc5v0_usb3_otg";
		regulator-min-microvolt = <5000000>;
		regulator-max-microvolt = <5000000>;
		enable-active-high;
		gpio = <&gpio4 RK_PA7 GPIO_ACTIVE_HIGH>;
		pinctrl-names = "default";
		pinctrl-0 = <&vcc5v0_usb3_otg_en>;
		vin-supply = <&vcc5v0_sys>;
	};

	vcc_cam0: vcc-cam0-regulator {
		pinctrl-names = "default";
		pinctrl-0 = <&csi0_pwr>;
		compatible = "regulator-fixed";
		/* Used by RAW probe for cameras connected via I2C */
		regulator-boot-on;
		regulator-always-on;
		enable-active-high;
		gpio = <&gpio2 RK_PC5 GPIO_ACTIVE_HIGH>;
		regulator-name = "vcc_cam0";
		startup-delay-us = <250000>;
	};

	vcc_cam1: vcc-cam1-regulator {
		pinctrl-names = "default";
		pinctrl-0 = <&csi1_pwr>;
		compatible = "regulator-fixed";
		/* Used by RAW probe for cameras connected via I2C */
		regulator-boot-on;
		regulator-always-on;
		enable-active-high;
		gpio = <&gpio4 RK_PC6 GPIO_ACTIVE_HIGH>;
		regulator-name = "vcc_cam1";
		startup-delay-us = <250000>;
	};

	hdmi0_sound: hdmi0-sound {
		status = "okay";
		compatible = "rockchip,hdmi";
		rockchip,mclk-fs = <128>;
		rockchip,card-name = "rockchip-hdmi0";
		rockchip,cpu = <&i2s5_8ch>;
		rockchip,codec = <&hdmi0>;
		rockchip,jack-det;
	};

	hdmi1_sound: hdmi1-sound {
		status = "okay";
		compatible = "rockchip,hdmi";
		rockchip,mclk-fs = <128>;
		rockchip,card-name = "rockchip-hdmi1";
		rockchip,cpu = <&i2s6_8ch>;
		rockchip,codec = <&hdmi1>;
		rockchip,jack-det;
	};

	pcie_refclk: pcie-refclk-clock {
		pinctrl-names = "default";
		pinctrl-0 = <&pcie30_clk_pins>;
		compatible = "gpio-gate-clock";
		clocks = <&pcie_refclk_gen>;
		#clock-cells = <0>;
		enable-gpios = <&gpio1 RK_PB3 GPIO_ACTIVE_HIGH>;
	};

	pcie_refclk_gen: pcie-refclk-gen-clock {
		compatible = "fixed-clock";
		#clock-cells = <0>;
		clock-frequency = <100000000>;
	};

	sensor_clk: sensor_clk {
        compatible = "fixed-clock";
        #clock-cells = <0>;
        clock-frequency = <24000000>;
    };

	cluster0_opp_table_m: opp-table-cluster0 {
		compatible = "operating-points-v2";
		opp-shared;

		opp-1008000000 {
			opp-hz = /bits/ 64 <1008000000>;
			opp-microvolt = <675000 675000 950000>;
			clock-latency-ns = <40000>;
		};
		opp-1200000000 {
			opp-hz = /bits/ 64 <1200000000>;
			opp-microvolt = <712500 712500 950000>;
			clock-latency-ns = <40000>;
		};
		opp-1416000000 {
			opp-hz = /bits/ 64 <1416000000>;
			opp-microvolt = <762500 762500 950000>;
			clock-latency-ns = <40000>;
			opp-suspend;
		};
		opp-1608000000 {
			opp-hz = /bits/ 64 <1608000000>;
			opp-microvolt = <850000 850000 950000>;
			clock-latency-ns = <40000>;
		};
		opp-1800000000 {
			opp-hz = /bits/ 64 <1800000000>;
			opp-microvolt = <950000 950000 950000>;
			clock-latency-ns = <40000>;
		};
	};

	cluster1_opp_table_m: opp-table-cluster1 {
		compatible = "operating-points-v2";
		opp-shared;

		opp-1200000000 {
			opp-hz = /bits/ 64 <1200000000>;
			opp-microvolt = <675000 675000 1000000>;
			clock-latency-ns = <40000>;
		};
		opp-1416000000 {
			opp-hz = /bits/ 64 <1416000000>;
			opp-microvolt = <725000 725000 1000000>;
			clock-latency-ns = <40000>;
		};
		opp-1608000000 {
			opp-hz = /bits/ 64 <1608000000>;
			opp-microvolt = <762500 762500 1000000>;
			clock-latency-ns = <40000>;
		};
		opp-1800000000 {
			opp-hz = /bits/ 64 <1800000000>;
			opp-microvolt = <850000 850000 1000000>;
			clock-latency-ns = <40000>;
		};
		opp-2016000000 {
			opp-hz = /bits/ 64 <2016000000>;
			opp-microvolt = <925000 925000 1000000>;
			clock-latency-ns = <40000>;
		};
		opp-2208000000 {
			opp-hz = /bits/ 64 <2208000000>;
			opp-microvolt = <987500 987500 1000000>;
			clock-latency-ns = <40000>;
		};
		opp-2400000000 {
			opp-hz = /bits/ 64 <2400000000>;
			opp-microvolt = <1000000 1000000 1000000>;
			clock-latency-ns = <40000>;
		};
	};

	cluster2_opp_table_m: opp-table-cluster2 {
		compatible = "operating-points-v2";
		opp-shared;

		opp-1200000000 {
			opp-hz = /bits/ 64 <1200000000>;
			opp-microvolt = <675000 675000 1000000>;
			clock-latency-ns = <40000>;
		};
		opp-1416000000 {
			opp-hz = /bits/ 64 <1416000000>;
			opp-microvolt = <725000 725000 1000000>;
			clock-latency-ns = <40000>;
		};
		opp-1608000000 {
			opp-hz = /bits/ 64 <1608000000>;
			opp-microvolt = <762500 762500 1000000>;
			clock-latency-ns = <40000>;
		};
		opp-1800000000 {
			opp-hz = /bits/ 64 <1800000000>;
			opp-microvolt = <850000 850000 1000000>;
			clock-latency-ns = <40000>;
		};
		opp-2016000000 {
			opp-hz = /bits/ 64 <2016000000>;
			opp-microvolt = <925000 925000 1000000>;
			clock-latency-ns = <40000>;
		};
		opp-2208000000 {
			opp-hz = /bits/ 64 <2208000000>;
			opp-microvolt = <987500 987500 1000000>;
			clock-latency-ns = <40000>;
		};
		opp-2400000000 {
			opp-hz = /bits/ 64 <2400000000>;
			opp-microvolt = <1000000 1000000 1000000>;
			clock-latency-ns = <40000>;
		};
	};

	gpio-leds {
		compatible = "gpio-leds";
		pinctrl-names = "default";
		pinctrl-0 = <&leds_som_pins>;

		led-live {
			label = "som:live";
			gpios = <&gpio0 RK_PA0 GPIO_ACTIVE_HIGH>;
			function = LED_FUNCTION_HEARTBEAT;
			color = <LED_COLOR_ID_GREEN>;
			linux,default-trigger = LED_FUNCTION_HEARTBEAT;
			default-state = "off";
			panic-indicator;
		};
	};

	/* If hdmirx node is disabled, delete the reserved-memory node here. */
	reserved-memory {
		#address-cells = <2>;
		#size-cells = <2>;
		ranges;

		/* Reserve 256MB memory for hdmirx-controller@fdee0000 */
		cma {
			compatible = "shared-dma-pool";
			reusable;
			reg = <0x0 (256 * 0x100000) 0x0 (256 * 0x100000)>;
			linux,cma-default;
		};
	};

	hdmiin-sound {
		compatible = "rockchip,hdmi";
		rockchip,mclk-fs = <128>;
		rockchip,format = "i2s";
		rockchip,bitclock-master = <&hdmirx_ctrler>;
		rockchip,frame-master = <&hdmirx_ctrler>;
		rockchip,card-name = "rockchip-hdmiin";
		rockchip,cpu = <&i2s7_8ch>;
		rockchip,codec = <&hdmirx_ctrler 0>;
		rockchip,jack-det;
	};

	backlight: backlight {
		compatible = "pwm-backlight";
		pwms = <&pwm13 0 1000 0>;
		brightness-levels = <0 255>;
		num-interpolated-steps = <256>;
		default-brightness-level = <100>;
	};

	fan0: pwm-fan {
		compatible = "pwm-fan";
		#cooling-cells = <2>;
		cooling-levels = <72 94 117 139 162 184 207 229 255>;
		pwms = <&pwm1 0 10000 0>;
	};

	thermal-sensor {
		compatible = "generic-adc-thermal";
		#thermal-sensor-cells = <0>;
		io-channels = <&saradc 3>;
		io-channel-names = "sensor-channel";
		temperature-lookup-table = <0 603
					    25000 1309
					    50000 2172
					    75000 2905>;
	};
};

&can1 {
	status = "okay";
	pinctrl-names = "default";
	pinctrl-0 = <&can1m1_pins>;
	assigned-clocks = <&cru CLK_CAN1>;
	assigned-clock-rates = <200000000>;
};

&can2 {
	status = "okay";
	pinctrl-names = "default";
	pinctrl-0 = <&can2m1_pins>;
	assigned-clocks = <&cru CLK_CAN2>;
	assigned-clock-rates = <200000000>;
};

&cpu_b0 {
	cpu-supply = <&vdd_cpu_big0_s0>;
	// mem-supply = <&vdd_cpu_big0_s0>;
	operating-points-v2 = <&cluster1_opp_table_m>;
};

&cpu_b1 {
	cpu-supply = <&vdd_cpu_big0_s0>;
	// mem-supply = <&vdd_cpu_big0_s0>;
	operating-points-v2 = <&cluster1_opp_table_m>;
};

&cpu_b2 {
	cpu-supply = <&vdd_cpu_big1_s0>;
	// mem-supply = <&vdd_cpu_big1_s0>;
	operating-points-v2 = <&cluster2_opp_table_m>;
};

&cpu_b3 {
	cpu-supply = <&vdd_cpu_big1_s0>;
	// mem-supply = <&vdd_cpu_big1_s0>;
	operating-points-v2 = <&cluster2_opp_table_m>;
};

&cpu_l0 {
	cpu-supply = <&vdd_cpu_lit_s0>;
	// mem-supply = <&vdd_cpu_lit_s0>;
	operating-points-v2 = <&cluster0_opp_table_m>;
};

&cpu_l1 {
	cpu-supply = <&vdd_cpu_lit_s0>;
	// mem-supply = <&vdd_cpu_lit_s0>;
	operating-points-v2 = <&cluster0_opp_table_m>;
};

&cpu_l2 {
	cpu-supply = <&vdd_cpu_lit_s0>;
	// mem-supply = <&vdd_cpu_lit_s0>;
	operating-points-v2 = <&cluster0_opp_table_m>;
};

&cpu_l3 {
	cpu-supply = <&vdd_cpu_lit_s0>;
	// mem-supply = <&vdd_cpu_lit_s0>;
	operating-points-v2 = <&cluster0_opp_table_m>;
};

&combphy0_ps {
	/* pcie2x1l2 (PCIE20_0) */
	status = "okay";
};

&combphy1_ps {
	/* pcie2x1l0 (PCIE20_1) */
	status = "okay";
};

&combphy2_psu {
	status = "okay";
};

&csi2_dphy0 {
	status = "okay";

	ports {
		#address-cells = <1>;
		#size-cells = <0>;

		port@0 {
			reg = <0>;
			#address-cells = <1>;
			#size-cells = <0>;

			mipidphy0_in_ucam0: endpoint@1 {
				reg = <1>;
				remote-endpoint = <&imx335_i2c9_out>;
				data-lanes = <1 2 3 4>;
			};
		};

		port@1 {
			reg = <1>;
			#address-cells = <1>;
			#size-cells = <0>;

			csidphy0_out: endpoint@0 {
				reg = <0>;
				remote-endpoint = <&mipi2_csi2_input>;
			};
		};
	};
};

&csi2_dphy1 {
	status = "okay";

	ports {
		#address-cells = <1>;
		#size-cells = <0>;

		port@0 {
			reg = <0>;
			#address-cells = <1>;
			#size-cells = <0>;

			mipidphy1_in_ucam1: endpoint@1 {
				reg = <1>;
				remote-endpoint = <&imx335_i2c10_out>;
				data-lanes = <1 2 3 4>;
			};
		};

		port@1 {
			reg = <1>;
			#address-cells = <1>;
			#size-cells = <0>;

			csidphy1_out: endpoint@0 {
				reg = <0>;
				remote-endpoint = <&mipi4_csi2_input>;
			};
		};
	};
};

&csi2_dphy0_hw {
	status = "okay";
};

&csi2_dphy1_hw {
	status = "okay";
};

&display_subsystem {
	clocks = <&hdptxphy_hdmi0>, <&hdptxphy_hdmi1>;
	clock-names = "hdmi0_phy_pll", "hdmi1_phy_pll";
};

&dmc {
	center-supply = <&vdd_ddr_s0>;
	mem-supply = <&vdd_log_s0>;
	status = "okay";
};

&dfi {
	status = "okay";
};

&dp0 {
	status = "okay";
};

&dp0_in_vp2 {
	status = "okay";
};

&gmac0 {
	pinctrl-names = "default";
	pinctrl-0 = <&gmac0_miim &gmac0_tx_bus2 &gmac0_rx_bus2
		     &gmac0_rgmii_clk &gmac0_rgmii_bus &eth0_pins>;

	snps,reset-gpio = <&gpio0 RK_PC6 GPIO_ACTIVE_LOW>;
	snps,reset-active-low;
	/* Reset time is 20ms, 100ms for rtl8211f */
	snps,reset-delays-us = <0 20000 100000>;

	clock_in_out = "output";
	phy-handle = <&rgmii_phy0>;
	phy-mode = "rgmii-rxid";
	tx_delay = <0x43>;
	status = "okay";
};

&gmac1 {
	pinctrl-names = "default";
	pinctrl-0 = <&gmac1_miim &gmac1_tx_bus2 &gmac1_rx_bus2
		     &gmac1_rgmii_clk &gmac1_rgmii_bus &eth1_pins>;

	snps,reset-gpio = <&gpio0 RK_PD3 GPIO_ACTIVE_LOW>;
	snps,reset-active-low;
	/* Reset time is 20ms, 100ms for rtl8211f */
	snps,reset-delays-us = <0 20000 100000>;

	clock_in_out = "output";
	phy-handle = <&rgmii_phy1>;
	phy-mode = "rgmii-rxid";
	tx_delay = <0x43>;
	status = "okay";
};

&gpu_panthor {
	mali-supply = <&vdd_gpu_s0>;
	mem-supply = <&vdd_gpu_mem_s0>;
	status = "okay";
};

&hdptxphy_hdmi0 {
	status = "okay";
};

&hdptxphy_hdmi1 {
	status = "okay";
};

&hdmi0 {
	status = "okay";
	pinctrl-names = "default";
	pinctrl-0 = <&hdmim0_tx0_hpd>;
    // cec-enable = "true";

	force-bus-format = <MEDIA_BUS_FMT_RGB888_1X24>;
	force-output;
	force_timing{
		clock-frequency = <148500000>;
		hactive = <1920>;
		vactive = <720>;
		hback-porch = <148>;
		hfront-porch = <88>;
		vback-porch = <36>;
		vfront-porch = <4>;
		hsync-len = <44>;
		vsync-len = <5>;
		hsync-active = <1>;
		vsync-active = <1>;
		de-active = <0>;
		pixelclk-active = <0>;
	};

};

&hdmi0_in_vp0 {
	status = "okay";
};

&hdmi0_in_vp1 {
	status = "disabled";
};

&hdmi0_in_vp2 {
	status = "disabled";
};

&hdmi0_sound {
	status = "okay";
};

&hdmi1 {
	status = "okay";
	pinctrl-names = "default";
	pinctrl-0 = <&hdmim2_tx1_cec &hdmim1_tx1_hpd &hdmim1_tx1_scl &hdmim1_tx1_sda>;
    cec-enable = "true";
};

&hdmi1_in_vp0 {
	status = "disabled";
};

&hdmi1_in_vp1 {
	status = "okay";
};

&hdmi1_in_vp2 {
	status = "disabled";
};

&hdmi1_sound {
	status = "okay";
};

/* Should work with at least 128MB cma reserved above. */
&hdmirx_ctrler {
	status = "okay";

	#sound-dai-cells = <1>;
	/* Effective level used to trigger HPD: 0-low, 1-high */
	hpd-trigger-level = <1>;
	hdmirx-det-gpios = <&gpio3 RK_PC7 GPIO_ACTIVE_LOW>;

	pinctrl-0 = <&hdmim1_rx_cec &hdmim1_rx_hpdin &hdmim1_rx_scl &hdmim1_rx_sda &hdmirx_det>;
	pinctrl-names = "default";
};

&hdptxphy_hdmi0 {
	status = "okay";
};

&hdptxphy_hdmi1 {
	status = "okay";
};

&i2c0 {
	status = "okay";
	pinctrl-names = "default";
	pinctrl-0 = <&i2c0m2_xfer>;

	vdd_cpu_big0_s0: vdd_cpu_big0_mem_s0: rk8602@42 {
		compatible = "rockchip,rk8602";
		reg = <0x42>;
		vin-supply = <&vcc5v0_sys>;
		regulator-compatible = "rk860x-reg";
		regulator-name = "vdd_cpu_big0_s0";
		regulator-min-microvolt = <550000>;
		regulator-max-microvolt = <1050000>;
		regulator-ramp-delay = <2300>;
		rockchip,suspend-voltage-selector = <1>;
		regulator-boot-on;
		regulator-always-on;
		regulator-state-mem {
			regulator-off-in-suspend;
		};
	};

	vdd_cpu_big1_s0: vdd_cpu_big1_mem_s0: rk8603@43 {
		compatible = "rockchip,rk8603";
		reg = <0x43>;
		vin-supply = <&vcc5v0_sys>;
		regulator-compatible = "rk860x-reg";
		regulator-name = "vdd_cpu_big1_s0";
		regulator-min-microvolt = <550000>;
		regulator-max-microvolt = <1050000>;
		regulator-ramp-delay = <2300>;
		rockchip,suspend-voltage-selector = <1>;
		regulator-boot-on;
		regulator-always-on;
		regulator-state-mem {
			regulator-off-in-suspend;
		};
	};
};

&i2c1 {
	status = "okay";
	pinctrl-names = "default";
	pinctrl-0 = <&i2c1m4_xfer>;
	clock-frequency = <100000>;
};

&i2c2 {
	status = "okay";
	pinctrl-names = "default";
	pinctrl-0 = <&i2c2m0_xfer>;

	vdd_npu_s0: vdd_npu_mem_s0: rk8602@42 {
		compatible = "rockchip,rk8602";
		reg = <0x42>;
		vin-supply = <&vcc5v0_sys>;
		regulator-compatible = "rk860x-reg";
		regulator-name = "vdd_npu_s0";
		regulator-min-microvolt = <550000>;
		regulator-max-microvolt = <950000>;
		regulator-ramp-delay = <2300>;
		rockchip,suspend-voltage-selector = <1>;
		regulator-boot-on;
		regulator-always-on;
		regulator-state-mem {
			regulator-off-in-suspend;
		};
	};
};

&i2c3 {
	clock-frequency = <100000>;
	status = "okay";
	i2c_mux: i2c-mux@70 {
		pinctrl-0 = <&mux_pins>;
		pinctrl-names = "default";
		compatible = "nxp,pca9546";
		reg = <0x70>;
		i2c-mux-idle-disconnect;
		reset-gpios = <&gpio1 RK_PD5 GPIO_ACTIVE_HIGH>;
		vdd-supply = <&vcc_3v3_sys>;
		#address-cells = <1>;
		#size-cells = <0>;

		i2c9: i2c@0 {
			reg = <0>;
			#address-cells = <1>;
			#size-cells = <0>;
			imx335_i2c9: camera@1a {
				compatible = "sony,imx415";
				reg = <0x1a>;
				clocks = <&cru CLK_MIPI_CAMARAOUT_M1>;
				clock-names = "xvclk";
				pinctrl-names = "default";
				pinctrl-0 = <&mipim0_camera1_clk>;
				avdd-supply = <&vcc_cam0>;
				dvdd-supply = <&vcc_cam0>;
				ovdd-supply = <&vcc_cam0>;
				rockchip,camera-module-index = <0>;
				rockchip,camera-module-facing = "back";
				rockchip,camera-module-name = "IMX415";
				rockchip,camera-module-lens-name = "NC";
				status = "okay";

				port {
					imx335_i2c9_out: endpoint {
						data-lanes = <1 2 3 4>;
						remote-endpoint = <&mipidphy0_in_ucam0>;
						link-frequencies = /bits/ 64 <594000000>;
					};
				};
			};

			// imx678: camera@1a {
			// 	compatible = "sony,imx678";
			// 	reg = <0x1a>;
			// 	// clocks = <&sensor_clk>;
			// 	clocks = <&cru CLK_MIPI_CAMARAOUT_M1>;
			// 	clock-names = "inclk";
			// 	clock-frequency = <24000000>;
			// 	pinctrl-names = "default";
			// 	pinctrl-0 = <&mipim0_camera1_clk>;
			// 	csi-id = <0>;
			// 	reset-gpios = <&gpio1 RK_PA7 GPIO_ACTIVE_LOW>;
			// 	status = "okay";

			// 	port {
			// 		imx678_out: endpoint {
			// 			data-lanes = <1 2 3 4>;
			// 			remote-endpoint = <&mipidphy0_in_ucam0>;
			// 			link-frequencies = /bits/ 64 <891000000 1440000000 1782000000>;
			// 		};
			// 	};
			// };
		};

		i2c10: i2c@1 {
			reg = <1>;
			#address-cells = <1>;
			#size-cells = <0>;

			imx335_i2c10: camera@1a {
				compatible = "sony,imx415";
				reg = <0x1a>;
				clocks = <&cru CLK_MIPI_CAMARAOUT_M2>;
				clock-names = "xvclk";
				pinctrl-names = "default";
				pinctrl-0 = <&mipim0_camera2_clk>;
				avdd-supply = <&vcc_cam1>;
				dvdd-supply = <&vcc_cam1>;
				ovdd-supply = <&vcc_cam1>;
				rockchip,camera-module-index = <1>;
				rockchip,camera-module-facing = "back";
				rockchip,camera-module-name = "IMX415";
				rockchip,camera-module-lens-name = "NC";
				status = "okay";

				port {
					imx335_i2c10_out: endpoint {
						data-lanes = <1 2 3 4>;
						remote-endpoint = <&mipidphy1_in_ucam1>;
						link-frequencies = /bits/ 64 <594000000>;
					};
				};
			};
		};

		i2c11: i2c@2 {
			reg = <2>;
			#address-cells = <1>;
			#size-cells = <0>;

			usb@22 {
				pinctrl-names = "default";
				pinctrl-0 = <&fusb302_pins>;
				compatible = "fcs,fusb302";
				reg = <0x22>;
				interrupt-parent = <&gpio4>;
				interrupts = <RK_PA6 IRQ_TYPE_LEVEL_LOW>;
				int-n-gpios = <&gpio4 RK_PA6 GPIO_ACTIVE_LOW>;
				vbus-supply = <&vcc5v0_usb3_otg>;
				status = "okay";
				ports {
					#address-cells = <1>;
					#size-cells = <0>;
					port@0 {
						reg = <0>;
						usbc0_role_sw: endpoint {
							remote-endpoint = <&dwc3_0_role_switch>;
						};
					};
				};

				usb_con: connector {
					ccompatible = "usb-c-connector";
					label = "USB-C";
					data-role = "dual";
					power-role = "source";
					try-power-role = "sink";
					op-sink-microwatt = <1000000>;
					sink-pdos =
					<PDO_FIXED(5000, 1000, PDO_FIXED_USB_COMM)>;
					source-pdos =
					<PDO_FIXED(5000, 3000, PDO_FIXED_USB_COMM)>;

					altmodes {
						#address-cells = <1>;
						#size-cells = <0>;

						altmode@0 {
							reg = <0>;
							svid = <0xff01>;
							vdo = <0xffffffff>;
						};
					};

					ports {
						#address-cells = <1>;
						#size-cells = <0>;
						port@0 {
							reg = <0>;
							usbc0_orien_sw: endpoint {
								remote-endpoint = <&usbdp_phy0_orientation_switch>;
							};
						};

						port@1 {
							reg = <1>;
							dp_altmode_mux: endpoint {
								remote-endpoint = <&usbdp_phy0_dp_altmode_mux>;
							};
						};
					};
				};
			};
		};

		i2c12: i2c@3 {
			reg = <3>;
			#address-cells = <1>;
			#size-cells = <0>;
		};
	};
};

&i2c4 {
	status = "okay";
	pinctrl-names = "default";
	pinctrl-0 = <&i2c4m4_xfer>;
	clock-frequency = <100000>;
};

&i2c6 {
	clock-frequency = <100000>;
	status = "okay";

	brg: hdmi@51 {
		pinctrl-names = "default";
		pinctrl-0 = <&brg_pins>;
		compatible = "rockchip,rk628";
		reg = <0x51>;
		enable-gpios = <&gpio0 RK_PB0 GPIO_ACTIVE_HIGH>;
		// reset-gpios = <&gpio2 RK_PB5 GPIO_ACTIVE_HIGH>;

		panel-enable-gpios = <&gpio1 RK_PC4 GPIO_ACTIVE_HIGH>;
		panel-reset-gpios = <&gpio3 RK_PD5 GPIO_ACTIVE_LOW>;
		panel-backlight = <&backlight>;
		panel-reset-delay-ms = <10>;
		panel-enable-delay-ms = <10>;
		panel-prepare-delay-ms = <60>;
		panel-unprepare-delay-ms = <10>;
		panel-disable-delay-ms = <60>;
		status = "okay";

		rk628-hdmi-in;
		hpd-output-inverted;
		rk628-lvds-out {
			bus-format = "vesa_24";
			link-type = "dual_link_odd_even_pixels";
		};

		display-timings {
			src-timing {
				clock-frequency = <148500000>;
				hactive = <1920>;
				vactive = <720>;
				hback-porch = <148>;
				hfront-porch = <88>;
				vback-porch = <36>;
				vfront-porch = <4>;
				hsync-len = <44>;
				vsync-len = <5>;
				hsync-active = <1>;
				vsync-active = <1>;
				de-active = <0>;
				pixelclk-active = <0>;
			};

			dst-timing {
				clock-frequency = <148500000>;
				hactive = <1920>;
				vactive = <720>;
				hback-porch = <148>;
				hfront-porch = <88>;
				vback-porch = <36>;
				vfront-porch = <4>;
				hsync-len = <44>;
				vsync-len = <5>;
				hsync-active = <1>;
				vsync-active = <1>;
				de-active = <0>;
				pixelclk-active = <0>;
			};
	    };
	};

	rtc@68 {
		pinctrl-names = "default";
		pinctrl-0 = <&clk32k_in>;
		compatible = "st,m41t62";
		reg = <0x68>;

		clock {
			compatible = "fixed-clock";
			clock-accuracy = <2000>;
			clock-frequency = <32768>;
			clock-output-names = "xin32k";
			#clock-cells = <0>;
		};
	};
};

&iep {
	status = "okay";
};

&iep_mmu {
	status = "okay";
};

&isp0_mmu {
	status = "okay";
};

&jpegd {
	status = "okay";
};

&jpegd_mmu {
	status = "okay";
};

&jpege_ccu {
	status = "okay";
};

&jpege0 {
	status = "okay";
};

&jpege0_mmu {
	status = "okay";
};

&jpege1 {
	status = "okay";
};

&jpege1_mmu {
	status = "okay";
};

&jpege2 {
	status = "okay";
};

&jpege2_mmu {
	status = "okay";
};

&jpege3 {
	status = "okay";
};

&jpege3_mmu {
	status = "okay";
};

&mdio0 {
	rgmii_phy0: phy@0 {
		compatible = "ethernet-phy-id001c.c916",
			     "ethernet-phy-ieee802.3-c22";
		reg = <0x0>;
	};
};

&mdio1 {
	rgmii_phy1: phy@0 {
		compatible = "ethernet-phy-id001c.c916",
			     "ethernet-phy-ieee802.3-c22";
		reg = <0x0>;
	};
};

&mipi2_csi2 {
	status = "okay";

	ports {
		#address-cells = <1>;
		#size-cells = <0>;

		port@0 {
			reg = <0>;
			#address-cells = <1>;
			#size-cells = <0>;

			mipi2_csi2_input: endpoint@1 {
				reg = <1>;
				remote-endpoint = <&csidphy0_out>;
			};
		};

		port@1 {
			reg = <1>;
			#address-cells = <1>;
			#size-cells = <0>;

			mipi2_csi2_output: endpoint@0 {
				reg = <0>;
				remote-endpoint = <&cif_mipi2_in0>;
			};
		};
	};
};

&mipi4_csi2 {
	status = "okay";

	ports {
		#address-cells = <1>;
		#size-cells = <0>;

		port@0 {
			reg = <0>;
			#address-cells = <1>;
			#size-cells = <0>;

			mipi4_csi2_input: endpoint@1 {
				reg = <1>;
				remote-endpoint = <&csidphy1_out>;
			};
		};

		port@1 {
			reg = <1>;
			#address-cells = <1>;
			#size-cells = <0>;

			mipi4_csi2_output: endpoint@0 {
				reg = <0>;
				remote-endpoint = <&cif_mipi2_in4>;
			};
		};
	};
};

&mpp_srv {
	status = "okay";
};

&pcie2x1l2 {
	/* PCIE20_0 */
	// pinctrl-names = "default";
	// pinctrl-0 = <&pcie2x1l2_pins>;
	reset-gpios = <&gpio4 RK_PC1 GPIO_ACTIVE_HIGH>;
	vpcie3v3-supply = <&vcc_3v3_sys>;
	status = "okay";
};

&pcie2x1l0 {
	/* PCIE20_1 */
	// pinctrl-names = "default";
	// pinctrl-0 = <&pcie2x1l0_pins>;
	reset-gpios = <&gpio4 RK_PA5 GPIO_ACTIVE_HIGH>;
	vpcie3v3-supply = <&vcc_3v3_sys>;
	status = "okay";
};

&pcie30phy {
	status = "disabled";
};

&pcie3x4 {
	pinctrl-names = "default";
	// pinctrl-0 = <&pcie3x4_pins>;
	clocks = <&cru ACLK_PCIE_4L_MSTR>, <&cru ACLK_PCIE_4L_SLV>,
		 <&cru ACLK_PCIE_4L_DBI>, <&cru PCLK_PCIE_4L>,
		 <&cru CLK_PCIE_AUX0>, <&cru CLK_PCIE4L_PIPE>,
		 <&pcie_refclk>;
	clock-names = "aclk_mst", "aclk_slv",
		      "aclk_dbi", "pclk",
		      "aux", "pipe",
		      "ref";
	reset-gpios = <&gpio1 RK_PB2 GPIO_ACTIVE_HIGH>;
	vpcie3v3-supply = <&vcc3v3_pcie30>;
	status = "disabled";
};


&pwm1 {
	pinctrl-names = "active";
	pinctrl-0 = <&pwm1m2_pins>;
	status = "okay";
};

&pwm3 {
	pinctrl-names = "active";
	pinctrl-0 = <&pwm3m3_pins>;
	status = "okay";
};

&pwm4 {
	pinctrl-names = "active";
	pinctrl-0 = <&pwm4m1_pins>;
	status = "okay";
};

&pwm13 {
	status = "okay";
};

&pwm15 {
	pinctrl-names = "active";
	pinctrl-0 = <&pwm15m3_pins>;
	status = "okay";
};

&rga2 {
	status = "okay";
};

&rga3_core0 {
	status = "okay";
};

&rga3_0_mmu {
	status = "okay";
};

&rga3_core1 {
	status = "okay";
};

&rga3_1_mmu {
	status = "okay";
};

&rkvdec_ccu {
	status = "okay";
};

&rkvdec0 {
	status = "okay";
};

&rkvdec0_mmu {
	status = "okay";
};

&rkvdec1 {
	status = "okay";
};

&rkvdec1_mmu {
	status = "okay";
};

&rkvenc_ccu {
	status = "okay";
};

&rkvenc0 {
	status = "okay";
};

&rkvenc0_mmu {
	status = "okay";
};

&rkvenc1 {
	status = "okay";
};

&rkvenc1_mmu {
	status = "okay";
};

&rockchip_suspend {
	compatible = "rockchip,pm-rk3588";
	status = "okay";
	rockchip,sleep-debug-en = <1>;
	rockchip,sleep-mode-config = <
		(0
		| RKPM_SLP_ARMOFF_DDRPD
		)
	>;
	rockchip,wakeup-config = <
		(0
		| RKPM_GPIO_WKUP_EN
		| RKPM_USB_WKUP_EN
		)
	>;
};

&route_hdmi0 {
	status = "disabled";

};

&route_hdmi1 {
	status = "disabled";
};

&rkcif {
    status = "okay";
};

&rkcif_mmu {
    status = "okay";
};

&rkcif_mipi_lvds2 {
	status = "okay";

	port {
		cif_mipi2_in0: endpoint {
			remote-endpoint = <&mipi2_csi2_output>;
		};
	};
};

&rkcif_mipi_lvds4 {
	status = "okay";

	port {
		cif_mipi2_in4: endpoint {
			remote-endpoint = <&mipi4_csi2_output>;
		};
	};
};

&rkcif_mipi_lvds2_sditf {
	status = "okay";
	port {
		mipi_lvds2_sditf: endpoint {
			remote-endpoint = <&isp0_vir0>;
		};
	};
};

&rkcif_mipi_lvds4_sditf_vir1 {
	status = "okay";
	port {
		mipi_lvds4_sditf_vir1: endpoint {
			remote-endpoint = <&isp0_vir1>;
		};
	};
};

&rkisp0 {
	status = "okay";
};

&rkisp0_vir0 {
	status = "okay";
	port {
		#address-cells = <1>;
		#size-cells = <0>;

		isp0_vir0: endpoint@0 {
			reg = <0>;
			remote-endpoint = <&mipi_lvds2_sditf>;
		};
	};
};

&rkisp0_vir1 {
	status = "okay";
	port {
		#address-cells = <1>;
		#size-cells = <0>;

		isp0_vir1: endpoint@0 {
			reg = <0>;
			remote-endpoint = <&mipi_lvds4_sditf_vir1>;
		};
	};
};


&saradc {
	status = "okay";
	vref-supply = <&avcc_1v8_s0>;
};

&sdhci {
	bus-width = <8>;
	no-sdio;
	no-sd;
	non-removable;
	max-frequency = <200000000>;
	mmc-hs400-1_8v;
	mmc-hs400-enhanced-strobe;
	status = "okay";
};

&sdmmc {
	max-frequency = <200000000>;
	no-sdio;
	no-mmc;
	bus-width = <4>;
	cap-mmc-highspeed;
	cap-sd-highspeed;
	disable-wp;
	sd-uhs-sdr104;
	vmmc-supply = <&vcc_3v3_s3>;
	vqmmc-supply = <&vccio_sd_s0>;
	pinctrl-names = "default";
	pinctrl-0 = <&sdmmc_bus4 &sdmmc_clk &sdmmc_cmd &sdmmc_det>;
	status = "okay";
};

&soc_thermal {
	status = "okay";
};

&spi0 {
	pinctrl-0 = <&spi0m1_pins &spi0m1_cs1>;
	pinctrl-names = "default";
	num-cs = <2>;
	status = "okay";

	spi@1 {
		compatible = "rohm,dh2228fv";
		reg = <1>;
	};
};

&tsadc {
	status = "okay";
};

&uart6 {
	pinctrl-0 = <&uart6m1_xfer>;
	status = "okay";
};

&uart7 {
	pinctrl-0 = <&uart7m2_xfer &uart7_rts>;
	rts-gpios = <&gpio2 RK_PB5 GPIO_ACTIVE_LOW>;
	linux,rs485-enabled-at-boot-time;
	rs485-rx-during-tx;
	status = "okay";
};

&u2phy0 {
	status = "okay";
};

&u2phy0_otg {
	rockchip,typec-vbus-det;
	status = "okay";
};

&u2phy1 {
	status = "okay";
};

&u2phy1_otg {
	status = "okay";
};

&u2phy2 {
	status = "okay";
};

&u2phy2_host {
	status = "okay";
};

/* USB2.0 HOST*/
&u2phy3 {
	status = "okay";
};

&u2phy3_host {
	status = "okay";
};

&usb_host0_ohci {
	status = "okay";
};

&usb_host0_ehci {
	status = "okay";
};

&usb_host1_ehci {
	status = "okay";
};

&usb_host1_ohci {
	status = "okay";
};

&usbhost3_0 {
	status = "okay";
};

&usbhost_dwc3_0 {
	status = "okay";
};

&usbdp_phy0 {
	pinctrl-names = "default";
	pinctrl-0 = <&sbu_pins>;
	orientation-switch;
	svid = <0xff01>;
	sbu1-dc-gpios = <&gpio0 RK_PC5 GPIO_ACTIVE_HIGH>;
	sbu2-dc-gpios = <&gpio0 RK_PC4 GPIO_ACTIVE_HIGH>;
	status = "okay";

	port {
		#address-cells = <1>;
		#size-cells = <0>;
		usbdp_phy0_orientation_switch: endpoint@0 {
			reg = <0>;
			remote-endpoint = <&usbc0_orien_sw>;
		};

		usbdp_phy0_dp_altmode_mux: endpoint@1 {
			reg = <1>;
			remote-endpoint = <&dp_altmode_mux>;
		};
	};
};

&usbdp_phy0_u3 {
	status = "okay";
};

&usbdp_phy0_dp {
	status = "okay";
};

&usbdp_phy1 {
	status = "okay";
};

&usbdp_phy1_u3 {
	status = "okay";
};

&usbdrd3_0 {
	status = "okay";
};

&usbdrd_dwc3_0 {
	status = "okay";
	dr_mode = "otg";
	usb-role-switch;
	port {
		#address-cells = <1>;
		#size-cells = <0>;
		dwc3_0_role_switch: endpoint@0 {
			reg = <0>;
			remote-endpoint = <&usbc0_role_sw>;
		};
	};
};

&usbdrd3_1{
	status = "okay";
};

&usbdrd_dwc3_1{
	status = "okay";
};

&vdpu {
	status = "okay";
};

&vdpu_mmu {
	status = "okay";
};

&vepu {
	status = "okay";
};

&vop {
	status = "okay";
};

&vop_mmu {
	status = "okay";
};

&vp0 {
	rockchip,plane-mask = <(1 << ROCKCHIP_VOP2_CLUSTER0 | 1 << ROCKCHIP_VOP2_ESMART0)>;
	rockchip,primary-plane = <ROCKCHIP_VOP2_CLUSTER0>;
	cursor-win-id = <ROCKCHIP_VOP2_ESMART0>;
};

&vp1 {
	rockchip,plane-mask = <(1 << ROCKCHIP_VOP2_CLUSTER1 | 1 << ROCKCHIP_VOP2_ESMART1)>;
	rockchip,primary-plane = <ROCKCHIP_VOP2_CLUSTER1>;
	cursor-win-id = <ROCKCHIP_VOP2_ESMART1>;
};

&vp2 {
	rockchip,plane-mask = <(1 << ROCKCHIP_VOP2_CLUSTER2 | 1 << ROCKCHIP_VOP2_ESMART2)>;
	rockchip,primary-plane = <ROCKCHIP_VOP2_CLUSTER2>;
	cursor-win-id = <ROCKCHIP_VOP2_ESMART2>;
};

&vp3 {
	rockchip,plane-mask = <(1 << ROCKCHIP_VOP2_CLUSTER3 | 1 << ROCKCHIP_VOP2_ESMART3)>;
	rockchip,primary-plane = <ROCKCHIP_VOP2_CLUSTER3>;
	cursor-win-id = <ROCKCHIP_VOP2_ESMART3>;
};


&avdd_0v75_s0 {
	regulator-state-mem {
		regulator-on-in-suspend;
		regulator-suspend-microvolt = <837500>;
	};
};

&avcc_1v8_s0 {
	regulator-state-mem {
		regulator-on-in-suspend;
		regulator-suspend-microvolt = <1800000>;
	};
};

&vcc_1v8_s0 {
	regulator-state-mem {
		regulator-on-in-suspend;
		regulator-suspend-microvolt = <1800000>;
	};
};

&vcc_3v3_s0 {
	regulator-state-mem {
		regulator-on-in-suspend;
		regulator-suspend-microvolt = <3300000>;
	};
};

&vdd_log_s0 {
	regulator-state-mem {
		regulator-on-in-suspend;
		regulator-suspend-microvolt = <750000>;
	};
};

&vdd_ddr_pll_s0 {
	regulator-state-mem {
		regulator-on-in-suspend;
		regulator-suspend-microvolt = <850000>;
	};
};

&pinctrl {
	brg {
		brg_pins: brg-pins {
			rockchip,pins =
				// <2 RK_PB5 GPIO_ACTIVE_LOWR;K_FUNC_GPIO &pcfg_pull_down>, /* RESET_RK628 */
				<0 RK_PB0 RK_FUNC_GPIO &pcfg_pull_up>,	/* LVDS_BRG_EN */
				<3 RK_PD5 RK_FUNC_GPIO &pcfg_pull_none>,	/* LCD_nRESET */
				<1 RK_PC4 RK_FUNC_GPIO &pcfg_pull_none>;	/* LCD_nSTBYB */
		};
	};

	csi {
		/* csi0 clkout = cif_clk */

		csi0_pwr: csi0-pwr-pins {
			rockchip,pins =
				<2 RK_PC5 RK_FUNC_GPIO &pcfg_pull_up>;		/* CSI_PWREN0 */
		};

		csi1_pwr: csi1-pwr-pins {
			rockchip,pins =
				<4 RK_PC6 RK_FUNC_GPIO &pcfg_pull_up>;		/* CSI_PWREN1 */
		};
	};

	hdmi {
		hdmi0_scl: hdmi0-scl {
			rockchip,pins =
				<0 RK_PD5 11 &pcfg_pull_up>;
		};
		hdmi0_sda: hdmi0-sda {
			rockchip,pins =
				<0 RK_PD4 11 &pcfg_pull_up>;
		};
	};
	leds {
		leds_som_pins: leds-som-pins {
			rockchip,pins =
				<0 RK_PA0 RK_FUNC_GPIO &pcfg_pull_none>;	/* VD2 */
		};
	};

	mux {
		mux_pins: mux-pins {
			rockchip,pins =
				<1 RK_PD5 RK_FUNC_GPIO &pcfg_pull_up>;		/* CAM_I2C_MUX_RST */
		};
	};

	pcie {
		pcie2x1l2_pins: pcie2x1l0-pins {
			rockchip,pins =
				<4 RK_PB7 4 &pcfg_pull_none>,			/* pcie20x1_2_clkreqn_m1 */
				// <4 RK_PC1 RK_FUNC_GPIO &pcfg_pull_none>,	/* pcie20x1_2_perstn_m1 */
				<4 RK_PC0 4 &pcfg_pull_none>;			/* pcie20x1_2_waken_m1 */
		};

		pcie2x1l0_pins: pcie2x1l2-pins {
			rockchip,pins =
				<4 RK_PA3 4 &pcfg_pull_none>,			/* pcie30x1_0_clkreqn_m1 */
				// <4 RK_PA5 RK_FUNC_GPIO &pcfg_pull_none>,	/* pcie30x1_0_perstn_m1 */
				<4 RK_PA4 4 &pcfg_pull_none>;			/* pcie30x1_0_waken_m1 */
		};

		pcie30_clk_pins: pcie30-clk-pins {
			rockchip,pins =
				<1 RK_PB3 RK_FUNC_GPIO &pcfg_pull_none>;	/* PCIE30_CLK_PWREN */
		};

		// pcie30_oe_pins: pcie30-oe-pins {
		// 	rockchip,pins =
		// 		<1 RK_PB3 RK_FUNC_GPIO &pcfg_pull_up>;		/* PCIECLKIC_OE */
		// };

		pcie30_vcc_pins: pcie30-vcc-pins {
			rockchip,pins =
				<1 RK_PC2 RK_FUNC_GPIO &pcfg_pull_none>;	/* PCIE30_PWREN */
		};

		pcie3x4_pins: pci3x4-pins {
			rockchip,pins =
				<1 RK_PB0 4 &pcfg_pull_none>,			/* pcie30x4_clkreqn_m3 */
				// <1 RK_PB2 RK_FUNC_GPIO &pcfg_pull_none>,	/* pcie30x4_perstn_m3 */
				<1 RK_PB1 4 &pcfg_pull_none>;			/* pcie30x4_waken_m3 */
		};
	};

	uart {
		uart7_rts: uart7-rts {
			rockchip,pins =
				<2 RK_PB5 RK_FUNC_GPIO &pcfg_pull_up>;
		};
	};
	usb {
		fusb302_pins: fusb302-pins {
			rockchip,pins =
				<4 RK_PA6 RK_FUNC_GPIO &pcfg_pull_none>;	/* TYPEC0_INT */
		};

		vcc5v0_usb2_host_en: vcc5v0-usb2-host-en {
			rockchip,pins = <4 RK_PB0 RK_FUNC_GPIO &pcfg_pull_none>;
		};

		vcc5v0_usb3_host1_en: vcc5v0-usb3-host1-en {
			rockchip,pins = <4 RK_PB6 RK_FUNC_GPIO &pcfg_pull_none>;
		};

		vcc5v0_usb3_host2_en: vcc5v0-usb3-host2-en {
			rockchip,pins = <1 RK_PD4 RK_FUNC_GPIO &pcfg_pull_none>;
		};

		vcc5v0_usb3_otg_en: vcc5v0-usb3-otg-en {
			rockchip,pins = <4 RK_PA7 RK_FUNC_GPIO &pcfg_pull_none>;
		};
	};

	usb-typec {
		usbc0_int: usbc0-int {
			rockchip,pins = <3 RK_PB4 RK_FUNC_GPIO &pcfg_pull_up>;
		};

		sbu_pins: sbu-pins {
			rockchip,pins =
				<0 RK_PC4 RK_FUNC_GPIO &pcfg_pull_none>,	/* TYPEC0_SBU2_DC */
				<0 RK_PC5 RK_FUNC_GPIO &pcfg_pull_none>;	/* TYPEC0_SBU1_DC */
		};
	};

	hdmirx {
		hdmirx_det: hdmirx-det {
			rockchip,pins = <3 RK_PC7 RK_FUNC_GPIO &pcfg_pull_none>;
		};
	};

	sdio-pwrseq {
		wifi_enable_h: wifi-enable-h {
			rockchip,pins = <0 RK_PC4 RK_FUNC_GPIO &pcfg_pull_none>;
		};
	};

};